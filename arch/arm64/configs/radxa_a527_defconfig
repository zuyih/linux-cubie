## bsp/drivers/net/wireless/aic8800/sdio/Kconfig
```kconfig
config AIC_FW_PATH
	depends on AIC_WLAN_SUPPORT
	string "Firmware & config file path"
	default "/lib/firmware/aic8800_fw/SDIO/aic8800D80"
	help
	  Path to the firmware & config file.

source "bsp/drivers/net/wireless/aic8800/sdio/aic8800_fdrv/Kconfig"
source "bsp/drivers/net/wireless/aic8800/sdio/aic8800_btlpm/Kconfig"
```
